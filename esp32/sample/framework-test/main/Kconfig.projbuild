## esp32/sample/framework-test/main/Kconfig.projbuild
```kconfig
menu "Example Configuration"

    config TEST_TIMEOUT
        int "test message timeout."
        default 5000
        help
            -

    config TEST_STACK_SIZE
        int "test thread stack size."
        default 1024
        help
            -

    config TEST_MESSAGE_SIZE
        int "test thread message size."
        default 512
        help
            -

    config TEST_THREAD_PRIORITY
        int "test thread priority."
        default 6
        help
            -

endmenu
```

## esp32/sample/gatt-client/main/Kconfig.projbuild
```kconfig
menu "Example 'GATT CLIENT' Config"

    config EXAMPLE_DUMP_ADV_DATA_AND_SCAN_RESP
        bool "Dump whole adv data and scan response data in example"
        default n

    config MULTIPUL_CONNECT
        bool "Use multipul connection"
        default n

    config UTIL_DEBUG_DUMP
        bool "Use debug dump"
        default n

endmenu
```

## odroid-xu/linux/drivers/misc/demo-driver/Kconfig
```kconfig
#
# device for demo subsystem configuration
#

config DEMO_DEV
	tristate "device for demo support"
	depends on I2C
	default m
	select RT_MUTEXES
	---help---
	  bme280/pwm(bcm2837)/sc1602bs
```

## odroid/linux/drivers/misc/demo-peripheral-driver/Kconfig
```kconfig
#
# device for demo subsystem for peripheral device configuration
#

config DEMO_PERIPHERAL_DEV
	tristate "device for demo support"
	depends on SPI
	default m
	select RT_MUTEXES
	---help---
	  bme280/pwm(bcm2837)/sc1602bs
```
